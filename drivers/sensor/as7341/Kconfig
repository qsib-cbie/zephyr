## drivers/sensor/as7341/Kconfig
```kconfig
# AS7341 spectral sensor configuration options

menuconfig AS7341
	bool "AS7341 sensor"
	depends on I2C
	help
	  Enable driver for AS7341 I2C-based spectral sensor.

if AS7341

choice
	prompt "AS7341 test mode"
	default AS7341_TEST_OFF
	help
	  Select sampling mode. In normal mode continuous measurements are
	  performed, whereas in forced mode only single measurement is performed.
config AS7341_TEST_ON
	bool "allow failures in test mode"
config AS7341_TEST_OFF
	bool "disallow all failures"
endchoice


endif # AS7341
```

## drivers/sensor/bq25120a/Kconfig
```kconfig
# BQ25120A Battery Charger

menuconfig BQ25120A
	bool "BQ25120A Battery Charger"
	depends on I2C
	help
	  Enable BQ25120A Battery Charger
```

## drivers/sensor/mt29f/Kconfig
```kconfig
menuconfig MT29F 
	bool "MT29F External NAND"
	depends on SPI
	help 
		Provide your own drivers
```

## dts/bindings/sensor/ams,as7341.yaml
```yaml
description: AS7341 inertial measurement unit

compatible: "ams,as7341"

include: i2c-device.yaml

properties:
    int-gpios:
      type: phandle-array
      required: false
      description: |
        This property specifies the connection for INT1, because the
        Zephyr driver maps all interrupts to INT1.
```

## dts/bindings/sensor/mt29f.yaml
```yaml
description: MT29F External NAND over SPI

compatible: "mt29f"

include: spi-device.yaml
```

## dts/bindings/sensor/ti,bq25120a.yaml
```yaml
# SPDX-License-Identifier: Apache-2.0

description: BQ25120 Battery Charger

compatible: "ti,bq25120a"

include: i2c-device.yaml

properties:
    int-gpios:
      type: phandle-array
      required: false
      description: |
        This property specifies the connection for INT1, because the
        Zephyr driver maps all interrupts to INT1.  The signal defaults
        to output low when produced by the sensor.
```
